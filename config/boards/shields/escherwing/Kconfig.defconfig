## config/boards/shields/escherwing/Kconfig.defconfig
```kconfig
if BOARD_ESCHERWING_LEFT or BOARD_ESCHERWING_RIGHT

config ZMK_KEYBOARD_NAME
    default "escherwing"

config ZMK_USB
    default y

if USB

config USB_NRFX
    default y

config USB_DEVICE_STACK
    default y

endif # USB

config ZMK_BLE
    default y

config ZMK_BATTERY_VOLTAGE_DIVIDER
    default y

config ZMK_SLEEP
    default y

if ZMK_DISPLAY

config I2C
    default y

config SSD1306
    default y

config ZMK_DISPLAY_STATUS_SCREEN_BUILT_IN
    default y

config ZMK_LV_FONT_DEFAULT_SMALL_MONTSERRAT_26
    default y

config LV_Z_VDB_SIZE
    default 64

config LV_DPI_DEF
    default 148

config LV_Z_BITS_PER_PIXEL
    default 1

choice LV_COLOR_DEPTH
    default LV_COLOR_DEPTH_1
endchoice

endif # ZMK_DISPLAY

if ZMK_RGB_UNDERGLOW

config WS2812_STRIP
    default y

config SPI
    default y

endif # ZMK_RGB_UNDERGLOW

config ZMK_ENCODER
    default y

endif # BOARD_ESCHERWINGV2
```
